## test_apps/sdkconfig.defaults
```kconfig
CONFIG_PARTITION_TABLE_CUSTOM=y
CONFIG_ESPTOOLPY_FLASHSIZE_16MB=y
CONFIG_ESP_MAIN_TASK_STACK_SIZE=8192
CONFIG_ESP_CONSOLE_USB_SERIAL_JTAG=y
CONFIG_ESP_TASK_WDT_EN=n
CONFIG_FREERTOS_HZ=1000
CONFIG_GFX_FONT_FREETYPE_SUPPORT=y
CONFIG_MMAP_FILE_NAME_LENGTH=32
CONFIG_LV_FONT_FMT_TXT_LARGE=y
```
